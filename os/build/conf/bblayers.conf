## os/build/conf/bblayers.conf
```bitbake
# POKY_BBLAYERS_CONF_VERSION is increased each time build/conf/bblayers.conf
# changes incompatibly
POKY_BBLAYERS_CONF_VERSION = "2"

BBPATH = "${TOPDIR}"
BBFILES ?= ""

BBLAYERS ?= " \
  ${TOPDIR}/../src/poky/meta \
  ${TOPDIR}/../src/poky/meta-poky \
  ${TOPDIR}/../src/poky/meta-yocto-bsp \
  ${TOPDIR}/../src/meta-browser \
  ${TOPDIR}/../src/meta-clang \
  ${TOPDIR}/../src/meta-raspberrypi \
  ${TOPDIR}/../src/meta-openembedded/meta-oe \
  ${TOPDIR}/../src/meta-openembedded/meta-multimedia \
  ${TOPDIR}/../src/meta-openembedded/meta-networking \
  ${TOPDIR}/../src/meta-openembedded/meta-python \
  ${TOPDIR}/../src/meta-python2 \
  /home/eric/src/robot-fish/os/src/meta-robotfish \
  "
```

## os/src/meta-robot-fish/conf/distro/robot-fish.conf
```bitbake
require conf/distro/poky.conf
DISTRO = "robot-fish"
DISTRO_NAME = "Robot Fish"

hostname_pn-base-files = "robot-fish"

# Use systemd
DISTRO_FEATURES_append = " systemd"
DISTRO_FEATURES_BACKFILL_CONSIDERED += "sysvinit"
VIRTUAL-RUNTIME_login_manager = "shadow-base"
VIRTUAL-RUNTIME_init_manager = "systemd"
VIRTUAL-RUNTIME_initscripts = "systemd-compat-units"

DISTRO_FEATURES_remove = "pcmcia 3g nfc wayland zeroconf ldconfig"

# Boot images
SPLASH_IMAGE ?= "robot-fish-800x480.png"
SPLASH = "psplash-robot-fish"

INITRAMFS_IMAGE = "robot-fish-image-init" 

INITRAMFS_IMAGE_BUNDLE = "1"
```

## os/src/meta-robot-fish/conf/layer.conf
```bitbake
# We have a conf and classes directory, add to BBPATH
BBPATH .= ":${LAYERDIR}"

# We have recipes-* directories, add to BBFILES
BBFILES += "${LAYERDIR}/recipes-*/*/*.bb \
            ${LAYERDIR}/recipes-*/*/*.bbappend"

BBFILE_COLLECTIONS += "meta-robot-fish"
BBFILE_PATTERN_meta-robot-fish = "^${LAYERDIR}/"
BBFILE_PRIORITY_meta-robot-fish = "6"

LAYERDEPENDS_meta-robot-fish = "core"
LAYERSERIES_COMPAT_meta-robot-fish = "dunfell"
```

## os/src/meta-robotfish/conf/distro/robotfish.conf
```bitbake
require conf/distro/poky.conf
DISTRO = "robotfish"
DISTRO_NAME = "Robot Fish"

hostname_pn-base-files = "robotfish"

# Use systemd
DISTRO_FEATURES_append = " systemd"
DISTRO_FEATURES_BACKFILL_CONSIDERED += "sysvinit"
VIRTUAL-RUNTIME_login_manager = "shadow-base"
VIRTUAL-RUNTIME_init_manager = "systemd"
VIRTUAL-RUNTIME_initscripts = "systemd-compat-units"

DISTRO_FEATURES_remove = "pcmcia 3g nfc wayland zeroconf ldconfig"

# Boot images
SPLASH_IMAGE ?= "robotfish-800x480.png"
SPLASH = "psplash-robotfish"

INITRAMFS_IMAGE = "robotfish-image-init" 

INITRAMFS_IMAGE_BUNDLE = "1"
```

## os/src/meta-robotfish/conf/machine/raspberrypi0-wifi-robotfish.conf
```bitbake
require conf/machine/raspberrypio0-wifi.conf

MACHINEOVERRIDES_prepend := "raspberrypi0-wifi:"

DISABLE_SPLASH = "1"
ENABLE_UART = "1"

IMAGE_BOOT_FILES_remove = "${SDIMG_KERNELIMAGE}"
IMAGE_BOOT_FILES_append = " ${KERNEL_IMAGETYPE}-initramfs-${MACHINE}.bin;${SDIMG_KERNELIMAGE}"

# PREFERRED_VERSION_linux-raspberrypi = "5.4.%"
```

## os/src/meta-robotfish/conf/machine/raspberrypi4-robotfish.conf
```bitbake
require conf/machine/raspberrypi4.conf

MACHINEOVERRIDES_prepend := "raspberrypi4:"

DISABLE_SPLASH = "1"
ENABLE_UART = "1"

IMAGE_BOOT_FILES_remove = "${SDIMG_KERNELIMAGE}"
IMAGE_BOOT_FILES_append = " ${KERNEL_IMAGETYPE}-initramfs-${MACHINE}.bin;${SDIMG_KERNELIMAGE}"

# PREFERRED_VERSION_linux-raspberrypi = "5.4.%"
```
